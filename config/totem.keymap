#define CONFIG_WIRELESS
// Keep layer arguments in physical Totem order: rows, outer bottom keys, then thumbs.
#define ZMK_BASE_LAYER(name, LT, RT, LM, RM, XLB, LB, RB, XRB, XLH, LH, RH, XRH) \
    ZMK_LAYER(                                                                  \
        name,                                                                   \
                 LT RT                                                          \
                 LM RM                                                          \
        XLB       LB RB       XRB                                               \
        XLH       LH RH       XRH                                               \
    )

#include "zmk-helpers/key-labels/totem.h"
#include "base.keymap"
